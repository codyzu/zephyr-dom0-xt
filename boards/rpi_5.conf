## boards/rpi_5.conf
```kconfig
# Copyright (c) 2024 EPAM Systems
# SPDX-License-Identifier: Apache-2.0

CONFIG_XEN_DOM0=y

CONFIG_XSTAT=y
CONFIG_XSTAT_SHELL_CMDS=y

CONFIG_SHELL_STACK_SIZE=4096

CONFIG_MAIN_STACK_SIZE=8192
CONFIG_ISR_STACK_SIZE=8192

CONFIG_XEN_VCH=y
CONFIG_XEN_DOM0LESS_BOOT=y

CONFIG_USE_DEFAULT_DOM_CFG=n
CONFIG_DOM_CFG_BUILTIN_IMAGES=n

CONFIG_DOM_STORAGE_FATFS_ENABLE=y

CONFIG_FILE_SYSTEM_SHELL=y

CONFIG_NOCACHE_MEMORY=y
CONFIG_FS_MULTI_PARTITION=y
CONFIG_DOM_STORAGE_FATFS_LOGICAL_DRIVE_NAME="1"
CONFIG_DOM_STORAGE_FATFS_DIR="dom0/"
CONFIG_XEN_LIBFDT=y

CONFIG_DOM_CFG_LINUX_PV_DOMAIN=y

CONFIG_XRUN_STORAGE_DMA_DEBOUNCE=4

CONFIG_DOM_MAX=5

CONFIG_XEN_DOMCTL_INTERFACE_VERSION=0x16
CONFIG_XEN_DOMCTL_XENTROOPS_ARCH_VGSX_OSID=y
CONFIG_XEN_DOMCTL_XENTROOPS_ARCH_SCI_TYPE=y
```
